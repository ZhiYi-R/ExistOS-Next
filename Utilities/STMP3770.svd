# STMP3770 register map
Vendor: Freescale Semiconductor (NXP); Series: STMP37xx; File version: 1.0
STMP3770 应用处理器(ARM926EJ-S),HP39GII 计算器主控。寄存器定义源自 Freescale BSP 头文件，位域布局已验证与参考手册 Rev 1.04 一致。
CPU: other r0p0, little endian, no MPU, no FPU, 2 interrupt priority bits
Registers are 32-bit, read-write, reset 0x0 unless marked. A register's access mark holds for its fields unless they carry their own. Offsets are from the block's base; lines under a group give offsets from that group; [hi:lo] are bit positions; {n}, {i} and the like mark numbered series; 'fields as' and 'values as' point back to an identical list; <NAME> marks a mode.

## Memory map
0x80000000 ICOLL size 0x11F0 — ICOLL 中断收集器，负责 ARM926EJ-S 中断请求(IRQ)与快速中断请求(FIQ)的优先级仲裁、向量分发及状态管理。注：SRC 1(JTAG调试)由ARM JTAG TAP控制器直接处理，不经过ICOLL。
0x80004000 APBH size 0x4400 — AHB-to-APBH 桥 DMA 控制器(为 GPMI/NAND、LCDIF 等高速外设提供 DMA 通道)
0x80008000 ECC8 size 0xB0 — NAND ECC8/BCH 硬件纠错加速器(配合 GPMI 对 NAND 数据做 ECC 编解码)
0x8000C000 GPMI size 0x100 — NAND Flash 通用接口控制器，支持 NAND/ATA 模式，集成 ECC(BCH/ECC8) 纠错引擎，提供 DMA 数据传输、时序配置与命令执行功能。
0x80010000 SSP1 size 0x120 — 同步串行端口 1(SSP,支持 SD/MMC 卡与 SPI 主/从模式)
0x80018000 PINCTRL size 0xB30 — STMP3770 PINCTRL 引脚复用与 GPIO 控制器。提供 4 组物理引脚 Bank（Bank0~Bank3）的复用选择（MUXSEL）、驱动强度（DRIVE）、上拉电阻使能（PULL）、GPIO 输出数据（DOUT）、输入数据（DIN）、输出使能（DOE）以及中断配置（PIN2IRQ/IRQEN/IRQLEVEL/IRQPOL/IRQSTAT）。每引脚通过 2 位 MUXSEL 选择 0~3 共 4 种复用功能，值 3 通常映射为 GPIO 模式。DRIVE 寄存器按引脚配置输出驱动电流档位（_MA）与 I/O 电压域（_V）。PULL0/1/2 控制对应 Bank 的上拉电阻使能，PULL3 用于 Bank3 的 Pad Keeper 禁用。DOUT/DIN/DOE 以位掩码方式控制各 Bank 的 GPIO 输出值、输入采样值与方向。中断相关寄存器以位掩码逐引脚配置中断源选择、使能、电平/边沿触发、极性及状态。CTRL 寄存器提供模块级软复位（SFTRST）、时钟门控（CLKGATE）、Bank 存在标志（PRESENT）及中断输出路由（IRQOUT）。
0x8001C000 DIGCTL size 0x510 — STMP3770 DIGCTL 外设（数字控制/杂项）寄存器与位域中文描述。覆盖 slice 中全部寄存器与位域，名称逐字一致。
0x80020000 EMI size 0x100 — 外部存储器接口控制器(EMI,SDRAM/mDDR 时钟与读写时序配置)
0x80024000 APBX size 0x810 — AHB-to-APBX 桥 DMA 控制器(为音频、UARTAPP、I2C、LRADC 等低速外设提供 DMA 通道)
0x80028000 DCP size 0x440 — 数据协处理器(DCP,硬件 AES/SHA 加解密与哈希,支持内存拷贝/校验)
0x8002C000 OCOTP size 0x230 — 片上一次性可编程熔丝(OCOTP,存储芯片 ID、ROM 配置、密钥与硬件能力位)
0x80030000 LCDIF size 0x210 — STMP3770 LCDIF (eLCDIF) 显示控制器，支持 MPU/8080 并行接口、VSYNC 模式与 DOTCLK 模式，集成 DMA 帧缓冲、RGB-to-YCbCr 4:2:2 CSC 转换、DVI 输出及引脚共享仲裁。基地址 0x80030000。
0x80034000 SSP2 size 0x120
0x80040000 CLKCTRL size 0x150 — STMP3770 时钟控制单元 (CLKCTRL)，管理 480MHz USB PLL、CPU/HBUS/XBUS 总线分频、各外设时钟门控与分数分频器、时钟源旁路选择及系统软复位。
0x80042000 SAIF1 size 0x40 — 串行音频接口 1(SAIF,I2S 风格音频数据收发)
0x80044000 POWER size 0x140 — STMP3770 电源管理单元(POWER)寄存器与位域中文描述。涵盖电源控制、5V控制、低功耗、电池充电、各电源域(VDDD/VDDA/VDDIO)控制、DC-DC多输出转换、占空比限制、反馈环路、状态、晶体管速度、电池监测、复位、调试、测试及版本寄存器。注：VDD5V_DROOP(64)和DCDC4P2_BO(65)为POWER模块内部中断，不路由至ICOLL。
0x80046000 SAIF2 size 0x40
0x80048000 AUDIOOUT size 0x210 — 音频 DAC 输出(耳机/线路输出的音量、滤波与 DMA 控制)
0x8004C000 AUDIOIN size 0x90 — 音频 ADC 输入(麦克风/线路输入采集与 DMA 控制)
0x80050000 LRADC size 0x160 — STMP3770 LRADC 外设寄存器与位域中文描述
0x80054000 SPDIF size 0x70 — S/PDIF 数字音频发送接口
0x80058000 I2C size 0xA0 — I2C 总线控制器，支持主从模式、PIO/DMA 数据传输、可编程时序与多主机仲裁。
0x8005C000 RTC size 0xE0 — STMP3770 RTC (Real-Time Clock) 外设寄存器与位域中文描述
0x80064000 PWM size 0xC0 — 脉宽调制控制器(多通道 PWM 输出,可用于背光/蜂鸣等)
0x80068000 TIMROT size 0xB0 — STMP3770 TIMROT 外设：定时器与旋钮解码器。包含 4 个通用定时器（Timer0~3）和 1 个旋钮解码器，支持 PWM、晶振及旋钮输入等多种时钟源，可配置预分频、自动重载、中断等功能。ROTCTRL 控制旋钮解码器输入源、极性、过采样率及分频等；ROTCOUNT 保存旋钮旋转产生的计数值。各定时器通过 TIMCTRLn/TIMCOUNTn 寄存器组独立控制与计数。
0x8006C000 UARTAPP size 0xB0 — 应用 UART(高速 UART,支持 DMA 收发,区别于调试用 UARTDBG)
0x80070000 UARTDBG size 0x50 — STMP3770 UARTDBG 调试串口外设（ARM PrimeCell PL011 兼容），基地址 0x80070000，用于内核调试输出。包含数据收发、接收状态/错误清除、标志、红外低功耗计数、整数/小数波特率分频、线控、控制、FIFO 中断触发水平、中断屏蔽、原始中断状态、屏蔽后中断状态、中断清除及 DMA 控制等寄存器。
0x80074000 DRI size 0x70 — 数字无线电接口(DRI,串行调试/数据接口)
0x80078000 IR size 0xB0 — 红外接口控制器(IrDA/红外收发)
0x8007C000 USBPHY size 0xA0 — USB 2.0 收发 PHY 寄存器，包含电源关断、发送器/接收器控制、通用控制、状态、调试及 IP 版本等寄存器。
0x80080000 USBCTRL size 0x1F0 — ChipIdea/MXS USB 2.0 OTG 控制器（EHCI 兼容扩展），HP39GII 工作于 Device 模式。包含 EHCI 能力寄存器、USB 命令/状态/中断控制、端点队列管理（QH）、端口状态控制、OTG 状态控制及端点控制寄存器组。
0x800E0000 DRAM size 0xB0 — DRAM 控制器(mDDR/SDRAM 时序、刷新与校准配置寄存器)

## Interrupts
0 DEBUG_UART (UARTDBG)
2 SSP2_ERROR (SSP2)
3 VDD5V (POWER)
4 HEADPHONE_SHORT (AUDIOOUT)
5 DAC_DMA (AUDIOOUT)
6 DAC_ERROR (AUDIOOUT)
7 ADC_DMA (AUDIOIN)
8 ADC_ERROR (AUDIOIN)
9 SAIF2_DMA (SAIF2)
9 SPDIF_DMA (SPDIF)
10 SAIF1_IRQ (SAIF1)
10 SAIF2_IRQ (SAIF2)
10 SPDIF_ERROR (SPDIF)
11 USB_CTRL (USBCTRL)
12 USB_WAKEUP (USBCTRL)
13 GPMI_DMA (GPMI)
14 SSP1_DMA (SSP1)
15 SSP1_ERROR (SSP1)
16 GPIO0 (PINCTRL)
17 GPIO1 (PINCTRL)
18 GPIO2 (PINCTRL)
19 SAIF1_DMA (SAIF1)
20 SSP2_DMA (SSP2)
21 ECC8_IRQ (ECC8)
22 RTC_ALARM (RTC)
23 UARTAPP_TX_DMA (UARTAPP)
24 UARTAPP_INTERNAL (UARTAPP)
25 UARTAPP_RX_DMA (UARTAPP)
26 I2C_DMA (I2C)
27 I2C_ERROR (I2C)
28 TIMER0 (TIMROT)
29 TIMER1 (TIMROT)
30 TIMER2 (TIMROT)
31 TIMER3 (TIMROT)
32 BATT_BRNOUT (POWER)
33 VDDD_BRNOUT (POWER)
34 VDDIO_BRNOUT (POWER)
35 VDD18_BRNOUT (POWER)
36 TOUCH_DETECT (LRADC)
{n+37} LRADC_CH{n} (LRADC) (n=0..7)
45 LCDIF_DMA (LCDIF)
46 LCDIF_ERROR (LCDIF)
47 DIGCTL_DEBUG_TRAP (DIGCTL)
48 RTC_1MSEC (RTC)
49 DRI_DMA (DRI)
50 DRI_ATTENTION (DRI)
51 GPMI
52 IR
53 DCP_VMI (DCP)
54 DCP
64 VDD5V_DROOP (POWER)
65 DCDC4P2_BO (POWER)
